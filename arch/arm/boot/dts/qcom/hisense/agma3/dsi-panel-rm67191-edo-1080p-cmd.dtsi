/* Copyright (c) 2015, The Linux Foundation. All rights reserved.
 *
 * This program is free software; you can redistribute it and/or modify
 * it under the terms of the GNU General Public License version 2 and
 * only version 2 as published by the Free Software Foundation.
 *
 * This program is distributed in the hope that it will be useful,
 * but WITHOUT ANY WARRANTY; without even the implied warranty of
 * MERCHANTABILITY or FITNESS FOR A PARTICULAR PURPOSE.  See the
 * GNU General Public License for more details.
 */

&mdss_mdp {
	dsi_rm67191_edo_1080p_vid: qcom,mdss_dsi_rm67191_edo_1080p_cmd {
		qcom,mdss-dsi-panel-name = "edo rm67191 fhd";
		qcom,mdss-dsi-panel-controller = <&mdss_dsi0>;
		qcom,mdss-dsi-panel-type = "dsi_cmd_mode";
		qcom,mdss-dsi-panel-destination = "display_1";
		qcom,mdss-dsi-panel-framerate = <60>;
		qcom,mdss-dsi-virtual-channel-id = <0>;
		qcom,mdss-dsi-stream = <0>;
		qcom,mdss-dsi-panel-width = <1080>;
		qcom,mdss-dsi-panel-height = <1920>;
        qcom,mdss-pan-physical-width-dimension = <68>;
        qcom,mdss-pan-physical-height-dimension = <121>;		
		qcom,mdss-dsi-h-front-porch = <8>;
		qcom,mdss-dsi-h-back-porch = <8>;
		qcom,mdss-dsi-h-pulse-width = <4>;
		qcom,mdss-dsi-h-sync-skew = <0>;
		qcom,mdss-dsi-v-back-porch = <7>;
		qcom,mdss-dsi-v-front-porch = <7>;
		qcom,mdss-dsi-v-pulse-width = <2>;
		qcom,mdss-dsi-h-left-border = <0>;
		qcom,mdss-dsi-h-right-border = <0>;
		qcom,mdss-dsi-v-top-border = <0>;
		qcom,mdss-dsi-v-bottom-border = <0>;
		qcom,mdss-dsi-bpp = <24>;
		qcom,mdss-dsi-underflow-color = <0xff>;
		qcom,mdss-dsi-border-color = <0>;
		qcom,mdss-dsi-h-sync-pulse = <0>;
		qcom,mdss-dsi-traffic-mode = "burst_mode";
		qcom,mdss-dsi-bllp-eof-power-mode;
		qcom,mdss-dsi-bllp-power-mode;
		qcom,mdss-dsi-lane-0-state;
		qcom,mdss-dsi-lane-1-state;
		qcom,mdss-dsi-lane-2-state;
		qcom,mdss-dsi-lane-3-state;
		qcom,mdss-dsi-tx-eot-append;
		qcom,mdss-dsi-dma-trigger = "trigger_sw";
		qcom,mdss-dsi-mdp-trigger = "none";
		qcom,mdss-dsi-on-command = [
		  15 01 00 00 00 00 02 FE 0E
15 01 00 00 00 00 02 4B 00
15 01 00 00 00 00 02 4C 0F
15 01 00 00 00 00 02 4D 20
15 01 00 00 00 00 02 4E 40
15 01 00 00 00 00 02 4F 60
15 01 00 00 00 00 02 50 A0
15 01 00 00 00 00 02 51 C0	
15 01 00 00 00 00 02 52 E0		
15 01 00 00 00 00 02 53 FF		
15 01 00 00 00 00 02 FE 0D
15 01 00 00 00 00 02 18 08
15 01 00 00 00 00 02 42 01
15 01 00 00 00 00 02 08 41
15 01 00 00 00 00 02 46 02
15 01 00 00 00 00 02 72 09
15 01 00 00 00 00 02 FE 0A
15 01 00 00 00 00 02 24 17
15 01 00 00 00 00 02 04 07
15 01 00 00 00 00 02 1A 0C
15 01 00 00 00 00 02 0F 44 
15 01 00 00 00 00 02 FE 04
15 01 00 00 00 00 02 00 0C	
15 01 00 00 00 00 02 0A E6
15 01 00 00 00 00 02 0B 8C
15 01 00 00 00 00 02 1A 12
15 01 00 00 00 00 02 29 93
15 01 00 00 00 00 02 2A 93
15 01 00 00 00 00 02 2F 02
15 01 00 00 00 00 02 31 02
15 01 00 00 00 00 02 33 05
15 01 00 00 00 00 02 37 2D
15 01 00 00 00 00 02 38 2D
15 01 00 00 00 00 02 3A 1E
15 01 00 00 00 00 02 3B 1E
15 01 00 00 00 00 02 3D 27
15 01 00 00 00 00 02 3F 80
15 01 00 00 00 00 02 40 40
15 01 00 00 00 00 02 41 E0
15 01 00 00 00 00 02 4F 2F
15 01 00 00 00 00 02 50 1E
15 01 00 00 00 00 02 FE 06
15 01 00 00 00 00 02 00 CC	
15 01 00 00 00 00 02 05 05	 
15 01 00 00 00 00 02 07 A2
15 01 00 00 00 00 02 08 CC	
15 01 00 00 00 00 02 0D 03
15 01 00 00 00 00 02 0F A2
15 01 00 00 00 00 02 32 CC	
15 01 00 00 00 00 02 37 05	
15 01 00 00 00 00 02 39 83
15 01 00 00 00 00 02 3A CC	
15 01 00 00 00 00 02 41 04
15 01 00 00 00 00 02 43 83
15 01 00 00 00 00 02 44 CC
15 01 00 00 00 00 02 49 05
15 01 00 00 00 00 02 4B A2
15 01 00 00 00 00 02 4C CC
15 01 00 00 00 00 02 51 03
15 01 00 00 00 00 02 53 A2
15 01 00 00 00 00 02 75 CC
15 01 00 00 00 00 02 7A 03
15 01 00 00 00 00 02 7C 83
15 01 00 00 00 00 02 7D CC
15 01 00 00 00 00 02 82 02	
15 01 00 00 00 00 02 84 83
15 01 00 00 00 00 02 85 EC
15 01 00 00 00 00 02 86 0F
15 01 00 00 00 00 02 87 FF
15 01 00 00 00 00 02 88 00
15 01 00 00 00 00 02 8A 02	
15 01 00 00 00 00 02 8C A2
15 01 00 00 00 00 02 8D EA
15 01 00 00 00 00 02 8E 01
15 01 00 00 00 00 02 8F E8
15 01 00 00 00 00 02 FE 06
15 01 00 00 00 00 02 90 0A
15 01 00 00 00 00 02 92 06
15 01 00 00 00 00 02 93 A0
15 01 00 00 00 00 02 94 A8
15 01 00 00 00 00 02 95 EC
15 01 00 00 00 00 02 96 0F
15 01 00 00 00 00 02 97 FF
15 01 00 00 00 00 02 98 00
15 01 00 00 00 00 02 9A 02
15 01 00 00 00 00 02 9C A2
15 01 00 00 00 00 02 AC 04
15 01 00 00 00 00 02 FE 06
15 01 00 00 00 00 02 B1 12
15 01 00 00 00 00 02 B2 17
15 01 00 00 00 00 02 B3 17
15 01 00 00 00 00 02 B4 17
15 01 00 00 00 00 02 B5 17
15 01 00 00 00 00 02 B6 11
15 01 00 00 00 00 02 B7 08
15 01 00 00 00 00 02 B8 09
15 01 00 00 00 00 02 B9 06
15 01 00 00 00 00 02 BA 07
15 01 00 00 00 00 02 BB 17
15 01 00 00 00 00 02 BC 17
15 01 00 00 00 00 02 BD 17
15 01 00 00 00 00 02 BE 17
15 01 00 00 00 00 02 BF 17
15 01 00 00 00 00 02 C0 17
15 01 00 00 00 00 02 C1 17
15 01 00 00 00 00 02 C2 17
15 01 00 00 00 00 02 C3 17
15 01 00 00 00 00 02 C4 0F
15 01 00 00 00 00 02 C5 0E
15 01 00 00 00 00 02 C6 00
15 01 00 00 00 00 02 C7 01
15 01 00 00 00 00 02 C8 10
15 01 00 00 00 00 02 FE 00
15 01 00 00 00 00 02 C2 08
15 01 00 00 00 00 02 35 00						
29 01 00 00 00 00 03 44 03 80				
15 01 00 00 00 00 02 51 00
05 01 00 00 78 00 02 11 00
05 01 00 00 14 00 02 29 00];
		qcom,mdss-dsi-off-command = [05 01 00 00 0A 00 02 28 00
				 05 01 00 00 96 00 02 10 00];
		qcom,mdss-dsi-on-command-state = "dsi_lp_mode";
		qcom,mdss-dsi-off-command-state = "dsi_lp_mode";
		qcom,mdss-dsi-bl-min-level = <2>;
		qcom,mdss-dsi-bl-max-level = <255>;
		qcom,mdss-dsi-bl-pmic-control-type = "bl_ctrl_dcs";
		qcom,mdss-dsi-reset-sequence = <1 10>, <0 20>, <1 20>;
		qcom,mdss-dsi-te-pin-select = <1>;
		qcom,mdss-dsi-te-dcs-command = <1>;
		qcom,mdss-dsi-te-check-enable;
		qcom,mdss-dsi-te-using-te-pin;
		qcom,mdss-dsi-wr-mem-start = <0x2c>;
		qcom,mdss-dsi-wr-mem-continue = <0x3c>;			
    qcom,mdss-dsi-lp11-init;        
    qcom,mdss-dsi-panel-orientation = "180";
		qcom,mdss-dsi-bl-dcs-dimspeed-control;
		qcom,mdss-dsi-bl-dcs-dimspeed-high-command = [15 01 00 00 00 00 02 53 20];
		qcom,mdss-dsi-bl-dcs-dimspeed-low-command = [15 01 00 00 00 00 02 53 28];
        //qcom,mdss-dsi-panel-rotation-type = "framework";
		/*esd check
		qcom,esd-check-enabled;
		qcom,mdss-dsi-panel-status-command-state = "dsi_lp_mode";
		qcom,mdss-dsi-panel-status-check-mode = "reg_read";
		qcom,mdss-dsi-panel-esd-check-register = <0x0a>;
		qcom,mdss-dsi-panel-esd-check-register-value = <0x9c>;*/        
	};
};

